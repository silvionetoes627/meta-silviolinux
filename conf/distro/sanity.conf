## conf/distro/sanity.conf
```bitbake
# ---------------------------------------------------------------------------
# conf/distro/sanity.conf
# Verificações de sanidade / compatibilidade da distro SilvioLinux Minimal
# ---------------------------------------------------------------------------

# Versão mínima do BitBake exigida (compatível com Poky 5.0 Scarthgap)
BB_MIN_VERSION = "2.8.0"

# Série de camadas suportada por esta distro
LAYERSERIES_CORENAMES = "scarthgap"
LAYERSERIES_COMPAT_silviolinux = "scarthgap"

# Distros com as quais o SilvioLinux foi testado (checagem do sanity.bbclass)
SANITY_TESTED_DISTROS ?= " \
    silviolinux-1.0 \
    poky-5.0 \
    ubuntu-22.04 \
    ubuntu-24.04 \
    debian-12 \
"

# Máquinas de referência suportadas oficialmente (32-bit)
SANITY_TESTED_MACHINES ?= " \
    qemux86 \
    genericx86 \
"

# Aviso de sanidade customizado exibido durante o parse
SANITY_SILVIOLINUX_WARNING = "Aviso: SilvioLinux Minimal 1.0 (Aurora) requer MACHINE de 32-bit (ex.: qemux86, genericx86) e DISTRO = 'silviolinux'."

python silviolinux_sanity_check() {
    distro = d.getVar('DISTRO')
    machine = d.getVar('MACHINE')
    if distro != 'silviolinux':
        bb.warn("SilvioLinux: variável DISTRO não está definida como 'silviolinux' (atual: %s)" % distro)
    tune = d.getVar('DEFAULTTUNE') or ''
    if '64' in tune or 'x86-64' in tune:
        bb.warn("SilvioLinux Minimal foi projetado para arquiteturas 32-bit (i586/i686). DEFAULTTUNE atual: %s" % tune)
}

addhandler silviolinux_sanity_check
silviolinux_sanity_check[eventmask] = "bb.event.ConfigParsed"
```

## conf/distro/silviolinux.conf
```bitbake
# ---------------------------------------------------------------------------
# conf/distro/silviolinux.conf
# SilvioLinux Minimal 1.0 "Aurora"
# Distribuição derivada do Poky (Yocto Project 5.0 Scarthgap)
# Perfil: 32-bit, ultra-minimalista, sem gerenciador de janelas
# ---------------------------------------------------------------------------

require conf/distro/poky.conf

# --- Identidade da distro ---------------------------------------------------
DISTRO = "silviolinux"
DISTRO_NAME = "SilvioLinux Minimal"
DISTRO_VERSION = "1.0"
DISTRO_CODENAME = "Aurora"
DISTRO_DESCRIPTION = "SilvioLinux Minimal 1.0 (Aurora) - Mini distribuição Linux 32-bit ultra-minimalista, sem WM, baseada em Poky/Yocto 5.0 Scarthgap"
DISTRO_HOME_URL = "https://silviolinux.dev.br"
MAINTAINER = "Sílvio <contato@silviolinux.dev.br>"

SILVIOLINUX_VERSION = "1.0"
SILVIOLINUX_CODENAME = "Aurora"

# --- Sanidade / compatibilidade --------------------------------------------
require conf/distro/sanity.conf

# --- Arquitetura alvo: 32-bit ------------------------------------------------
# Uso recomendado com MACHINE = "qemux86" ou similar i586/i686.
DEFAULTTUNE ?= "i586"
TCLIBC ?= "musl"
TARGET_ARCH = "i586"

# --- Gerenciamento de pacotes: opkg (formato ipk) ---------------------------
PACKAGE_CLASSES ?= "package_ipk"
IMAGE_FEATURES += "package-management"

# --- Sistema de init minimalista, sem systemd -------------------------------
DISTRO_FEATURES:remove = "systemd wayland x11 opengl vulkan pulseaudio bluetooth 3g nfc wifi"
VIRTUAL-RUNTIME_init_manager = "sysvinit"
VIRTUAL-RUNTIME_initscripts = "initscripts"
DISTRO_FEATURES_BACKFILL_CONSIDERED += "sysvinit systemd"
INIT_MANAGER = "sysvinit"

# --- Sem gerenciador de janelas / sem GUI -----------------------------------
DISTRO_FEATURES:remove += "x11 wayland directfb"
DISTRO_FEATURES:append = " ext2 largefile pcmcia usbgadget usbhost"

# --- Ferramentas mínimas garantidas na imagem base --------------------------
# Apenas: vim, vi (provido pelo busybox ou vim-tiny), nano, curl, wget
DISTRO_EXTRA_RDEPENDS += "vim nano curl wget"

# --- Sistema de arquivos raiz e imagem ---------------------------------------
IMAGE_FSTYPES ?= "ext4"
SILVIOLINUX_IMAGE_FSTYPE = "ext4"

# --- Bootloader: GRUB sem imagem de fundo -----------------------------------
PREFERRED_PROVIDER_virtual/bootloader = "grub"
GRUB_GFXSERIAL = "0"
SILVIOLINUX_GRUB_BACKGROUND = ""

# --- Versões / rótulos -------------------------------------------------------
DISTRO_VERSION = "${SILVIOLINUX_VERSION}-${SILVIOLINUX_CODENAME}"
SDK_VENDOR = "-silviolinuxsdk"
SDK_VERSION = "${@d.getVar('DISTRO_VERSION').replace('snapshot-${METADATA_REVISION}', 'snapshot')}"

# --- Licenciamento padrão ----------------------------------------------------
LICENSE_FLAGS_ACCEPTED += "commercial_curl commercial_wget"

# --- Repositórios opkg (feeds) usados na imagem final -----------------------
SILVIOLINUX_OPKG_FEED_BASE = "https://packages.silviolinux.dev.br/aurora"
```

## conf/layer.conf
```bitbake
# ---------------------------------------------------------------------------
# meta-silviolinux :: conf/layer.conf
# Camada Yocto/OpenEmbedded do SilvioLinux Minimal
# Baseado no Poky 5.0 "Scarthgap" (Yocto Project 5.0 LTS)
# ---------------------------------------------------------------------------

# Verifica se é uma camada compatível com bitbake >= 6 (Scarthgap)
BBPATH .= ":${LAYERDIR}"

BBFILES += "${LAYERDIR}/recipes-*/*/*.bb \
            ${LAYERDIR}/recipes-*/*/*.bbappend"

BBFILE_COLLECTIONS += "silviolinux"
BBFILE_PATTERN_silviolinux = "^${LAYERDIR}/"
BBFILE_PRIORITY_silviolinux = "10"

LAYERSERIES_COMPAT_silviolinux = "scarthgap"

LAYERDEPENDS_silviolinux = "core"

LAYERVERSION_silviolinux = "1"

# Nome amigável exibido em `bitbake-layers show-layers`
BBLAYERS_LAYERINDEX_NAME_silviolinux = "meta-silviolinux"
```

## wic/silviolinux-aurora.wks
```
# silviolinux-aurora.wks
# Kickstart do WIC para gerar a imagem final .ext4 com GRUB (sem imagem de fundo)
# do SilvioLinux Minimal 1.0 (Aurora) - alvo 32-bit

part /boot --source bootimg-pcbios --ondisk sda --label boot --active --align 1024
part /    --source rootfs --ondisk sda --fstype=ext4 --label silviolinux-root --align 1024

bootloader --ptable gpt --timeout=5 --append="root=/dev/sda2 rootfstype=ext4 rootwait console=ttyS0,115200"
```
